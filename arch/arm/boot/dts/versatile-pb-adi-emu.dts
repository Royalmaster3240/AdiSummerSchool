// SPDX-License-Identifier: GPL-2.0
#include "versatile-pb.dts"

/ {
	spi_adi_emu@0 {
		compatible = "adi,spi-adi-emu";
		#address-cells = <1>;
		#size-cells = <0>;
		iio_adc_emu@0 {
			reg = <0x0>;
			compatible = "iio_adc_emu";
			spi-max-frequency = <1000000>;

		};
	};
};
